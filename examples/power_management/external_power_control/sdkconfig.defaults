## examples/power_management/external_power_control/sdkconfig.defaults
```kconfig
# This "default" configuration is appended to all other configurations
CONFIG_PM_POWER_DOWN_PERIPHERAL_IN_LIGHT_SLEEP=n
CONFIG_PM_ENABLE=y
CONFIG_PM_DFS_INIT_AUTO=y
CONFIG_FREERTOS_USE_TICKLESS_IDLE=y

CONFIG_EXAMPLE_EVENT_QUEUE_LEN=5
CONFIG_EXAMPLE_EVENT_TASK_STACK_SIZE=4096
CONFIG_EXAMPLE_EVENT_TASK_PRIORITY=10

CONFIG_EXAMPLE_PM_LOCK_TYPE=2

CONFIG_EXAMPLE_USE_INTERNAL_PU_PD=y

CONFIG_EXAMPLE_GPIO_CONTROL_NUM=0
CONFIG_EXAMPLE_UART_NUM=0

CONFIG_EXAMPLE_UART_WAKEUP_THRESHOLD=3
CONFIG_EXAMPLE_SLEEP_TIMEOUT_US=8000000
```
